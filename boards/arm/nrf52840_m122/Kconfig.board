## boards/arm/nrf52840_m122/Kconfig.board
```kconfig
# Copyright (c) 2023 The ZMK Contributers
# SPDX-Licencse-Identifier: MIT

config BOARD_IBM122
    bool "IBM122"
    depends on SOC_NRF52840_QIAA
```

## boards/arm/nrf52840_m122/nrf52840_m122_defconfig
```kconfig
# Copyright (c) 2023 The ZMK Contributers
# SPDX-Licencse-Identifier: MIT

CONFIG_SOC_SERIES_NRF52X=y
CONFIG_SOC_NRF52840_QIAA=y
CONFIG_BOARD_IBM122=y
CONFIG_ARM_MPU=y

# enable GPIO
CONFIG_GPIO=y
CONFIG_GPIO_AS_PINRESET=y
CONFIG_PINCTRL=y

# config ZMK
CONFIG_ZMK_USB=y
CONFIG_ZMK_BLE=y
CONFIG_ZMK_BATTERY_REPORTING=y
CONFIG_ZMK_BLE_EXPERIMENTAL_FEATURES=y
CONFIG_ZMK_BLE_EXPERIMENTAL_CONN=y

CONFIG_USE_DT_CODE_PARTITION=y
CONFIG_BUILD_OUTPUT_UF2=y

CONFIG_MPU_ALLOW_FLASH_WRITE=y
CONFIG_NVS=y
CONFIG_SETTINGS_NVS=y
CONFIG_FLASH=y
CONFIG_FLASH_PAGE_LAYOUT=y
CONFIG_FLASH_MAP=y
```

## config/west.yml
```yaml
manifest:
  remotes:
    - name: zmkfirmware
      url-base: https://github.com/zmkfirmware
    - name: m122
      url-base: https://github.com/SvenHaedrich/m122_keyboard       
    # Additional modules containing boards/shields/custom code can be listed here as well
    # See https://docs.zephyrproject.org/3.2.0/develop/west/manifest.html#projects
  projects:
    - name: zmk
      remote: zmkfirmware
      revision: main
      import: app/west.yml
  self:
    path: config
```

## zmk-config/config/boards/arm/nrf52840_m122/Kconfig
```kconfig
# Copyright (c) 2023 The ZMK Contributers
# SPDX-Licencse-Identifier: MIT

config BOARD_ENABLE_DCDC
    bool "Enable DCDC mode"
    select SOC_DCDC_NRF52X
    default y
    depends on BOARD_IBM122
```

## zmk-config/config/boards/arm/nrf52840_m122/Kconfig.defconfig
```kconfig
# Copyright (c) 2023 The ZMK Contributers
# SPDX-Licencse-Identifier: MIT

if BOARD_IBM122

config ZMK_KEYBOARD_NAME
    default "IBM M122"

if USB_DEVICE_STACK

config USB_NRFX
    default y

endif # USB_DEVICE_STACK

config BT_CTLR
    default BT

config ZMK_BLE
    default y

config ZMK_USB
    default y

config ZMK_RTT_LOGGING
    default y

 config LOG_BACKEND_SHOW_COLOR
    default n

endif # BOARD_IBM122

config USE_DT_CODE_PARTITION
    default y
```

## zmk-config/config/boards/arm/nrf52840_m122/nrf52840_m122_defconfig
```kconfig
# Copyright (c) 2023 The ZMK Contributers
# SPDX-Licencse-Identifier: MIT

CONFIG_SOC_SERIES_NRF52X=y
CONFIG_SOC_NRF52840_QIAA=y
CONFIG_BOARD_IBM122=y
CONFIG_ARM_MPU=y

# enable GPIO
CONFIG_GPIO=y
CONFIG_GPIO_AS_PINRESET=y
CONFIG_PINCTRL=y

# report battery
CONFIG_ZMK_BATTERY_REPORTING=y

CONFIG_USE_DT_CODE_PARTITION=y
CONFIG_BUILD_OUTPUT_UF2=y

CONFIG_MPU_ALLOW_FLASH_WRITE=y
CONFIG_NVS=y
CONFIG_SETTINGS_NVS=y
CONFIG_FLASH=y
CONFIG_FLASH_PAGE_LAYOUT=y
CONFIG_FLASH_MAP=y
```
