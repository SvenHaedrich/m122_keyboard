## boards/svenhaedrich/nrf52840_m122/Kconfig.defconfig
```kconfig
# Copyright (c) 2023 The ZMK Contributers
# SPDX-Licencse-Identifier: MIT

if BOARD_NRF52840_M122

config ZMK_KEYBOARD_NAME
    default "IBM M122"

if USB_DEVICE_STACK

config USB_NRFX
    default y

endif # USB_DEVICE_STACK

config BT_CTLR
    default BT

endif # BOARD_NRF52840_M122
```

## boards/svenhaedrich/nrf52840_m122/Kconfig.nrf52840_m122
```kconfig
# Copyright (c) 2023 The ZMK Contributors
# SPDX-License-Identifier: MIT

config BOARD_NRF52840_M122
    select SOC_NRF52840_QIAA
    select ZMK_BOARD_COMPAT if BOARD_NRF52840_M122_ZMK
    imply RETAINED_MEM
    imply RETENTION
    imply RETENTION_BOOT_MODE

choice ZMK_BOOTMODE_MAGIC_VALUE_BOOTLOADER_TYPE
    default ZMK_BOOTMODE_MAGIC_VALUE_BOOTLOADER_TYPE_ADAFRUIT_NRF52
endchoice
```

## boards/svenhaedrich/nrf52840_m122/board.yml
```yaml
board:
  name: nrf52840_m122
  vendor: svenhaedrich
  socs:
    - name: nrf52840
      variants:
        - name: zmk
```
